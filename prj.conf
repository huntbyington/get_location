## CMakeLists.txt
```
cmake_minimum_required(VERSION 3.20.0)

find_package(Zephyr REQUIRED HINTS $ENV{ZEPHYR_BASE})
project(get_location)

target_sources(app PRIVATE 
                src/main.c
                src/location.c
                )
```

## Kconfig
```
menu "Location Sample"
    config GNSS_PERIODIC_INTERVAL
        int "Fix interval for periodic GPS fixes"
        range 0 65535
        default 120
        help
            Fix interval (in seconds) for periodic fixes.

    config GNSS_PERIODIC_TIMEOUT
        int "Fix timeout for periodic GPS fixes"
        range 0 65535
        default 480
        help
            Fix timeout (in seconds) for periodic fixes.
            If set to zero, GNSS is allowed to run indefinitely until a valid PVT estimate is produced.

    config GET_LOCATION_INTERVAL
        int "Interval between get location calls"
        range 1 32768
        default 1440
        help
          Time (in minutes) between get location requests. 
          Default value is equivalent to 24 hours.

    config LOCATION_THREAD_STACKSIZE
        int "Queue thread stack size in bytes"
        default 1024
        help
            Specifies the stack size for the queue thread. Adjust based on the thread's
            requirements and available memory.

    config LOCATION_THREAD_PRIORITY
        int "Queue thread priority"
        default 7
        help
            Sets the scheduling priority for the queue thread. 
            In Zephyr, lower numbers denote lower priority for preemptive threads.
            Use negative values for cooperative threads (higher priority).
endmenu

menu "Zephyr Kernel"
    source "Kconfig.zephyr"
endmenu
```

## prj.conf
```kconfig
# DK Library for Testing
CONFIG_DK_LIBRARY=y

# General config
CONFIG_FPU=y
CONFIG_NEWLIB_LIBC=y
CONFIG_NEWLIB_LIBC_FLOAT_PRINTF=y
CONFIG_NRF_MODEM_LIB=y

# Heap and stacks
CONFIG_MAIN_STACK_SIZE=2048
CONFIG_LOCATION_THREAD_STACKSIZE=4096
# Extended memory heap size needed for encoding REST messages to JSON
CONFIG_HEAP_MEM_POOL_SIZE=28672
CONFIG_SYSTEM_WORKQUEUE_STACK_SIZE=1536
# Increase AT monitor heap because %NCELLMEAS notifications can be large
CONFIG_AT_MONITOR_HEAP_SIZE=1024
# Thread Priority
CONFIG_LOCATION_THREAD_PRIORITY=4

# Location library
CONFIG_LOCATION=y

# Logging
CONFIG_LOG=y
CONFIG_LOG_MODE_IMMEDIATE=y

# Network
CONFIG_NETWORKING=y
CONFIG_NET_NATIVE=n
CONFIG_NET_SOCKETS=y
CONFIG_NET_SOCKETS_OFFLOAD=y

# LTE link control
CONFIG_LTE_LINK_CONTROL=y
CONFIG_LTE_LC_EDRX_MODULE=y
CONFIG_LTE_EDRX_REQ=y
CONFIG_LTE_LC_PSM_MODULE=y
# Request PSM active time of 8 seconds.
CONFIG_LTE_PSM_REQ_RAT="00000100"

# AT Host library - Used to send AT commands directy from an UART terminal and to allow
#		    integration with nRF Connect for Desktop LTE Link monitor application.
CONFIG_UART_INTERRUPT_DRIVEN=y
CONFIG_AT_HOST_LIBRARY=y

# nRF Cloud (for A-GNSS and cell location)
CONFIG_NRF_CLOUD=y
CONFIG_NRF_CLOUD_REST=y
CONFIG_NRF_CLOUD_AGNSS=n
CONFIG_NRF_CLOUD_PGPS=y
CONFIG_MODEM_INFO=y # required by CONFIG_NRF_CLOUD_AGNSS
CONFIG_MODEM_INFO_ADD_NETWORK=y # required by CONFIG_NRF_CLOUD_AGNSS

CONFIG_NRF_CLOUD_CLIENT_ID_SRC_INTERNAL_UUID=y

# Location Interval
CONFIG_GET_LOCATION_INTERVAL=1

# Library that maintains the current date time UTC for A-GNSS and P-GPS purposes
CONFIG_DATE_TIME=y

# Modem JWT
CONFIG_MODEM_JWT=y

# P-GPS
CONFIG_NRF_CLOUD_REST=y
CONFIG_NRF_CLOUD_PGPS=y
CONFIG_NRF_CLOUD_PGPS_REPLACEMENT_THRESHOLD=4

# Storage for P-GPS
CONFIG_STREAM_FLASH=y
CONFIG_FLASH=y
CONFIG_FLASH_PAGE_LAYOUT=y
CONFIG_FLASH_MAP=y
CONFIG_FCB=y
CONFIG_SETTINGS_FCB=y
CONFIG_MPU_ALLOW_FLASH_WRITE=y

# Download client library stack size needs to be increased with P-GPS
CONFIG_DOWNLOADER_STACK_SIZE=1280
```

## src/main.c
```c
#include "location.h"

#include <stdio.h>
#include <zephyr/kernel.h>
#include <zephyr/types.h>
#include <zephyr/logging/log.h>

#include <dk_buttons_and_leds.h> // For DK board LEDs/buttons

#include <modem/lte_lc.h>        // LTE link control (required for cellular)
#include <modem/nrf_modem_lib.h> // Modem initialization
#include <modem/modem_info.h>    // Signal strength, network info
#include <zephyr/net/net_mgmt.h> // Network management (for connection events)

LOG_MODULE_REGISTER(GET_LOCATION, LOG_LEVEL_INF);

K_SEM_DEFINE(location_start_thread, 0, 1);
K_THREAD_DEFINE(location_fsm_tid, CONFIG_LOCATION_THREAD_STACKSIZE, locationFSM,
                NULL, NULL, NULL, CONFIG_LOCATION_THREAD_PRIORITY, 0, 0);

#define EVENT_MASK (NET_EVENT_L4_CONNECTED | NET_EVENT_L4_DISCONNECTED)

static K_SEM_DEFINE(run_sample, 0, 1);

static void lte_event_handler(const struct lte_lc_evt *const evt)
{
    switch (evt->type)
    {
    case LTE_LC_EVT_NW_REG_STATUS:
        if ((evt->nw_reg_status == LTE_LC_NW_REG_REGISTERED_HOME) ||
            (evt->nw_reg_status == LTE_LC_NW_REG_REGISTERED_ROAMING))
        {
            printk("Connected to LTE\n");
            k_sem_give(&run_sample);
        }
        break;
    default:
        break;
    }
}

/* modem_configure() initializes an LTE connection */
static int modem_configure(void)
{
    int err;

    LOG_INF("Initializing modem library");
    err = nrf_modem_lib_init();
    if (err)
    {
        LOG_ERR("Failed to initialize the modem library, error: %d", err);
        return err;
    }

    LOG_INF("Connecting to LTE network");
    err = lte_lc_connect_async(lte_event_handler);
    if (err)
    {
        LOG_ERR("Error in lte_lc_connect_async, error: %d", err);
        return err;
    }
    return 0;
}

static void button_handler(uint32_t button_state, uint32_t has_changed)
{
    switch (has_changed)
    {
    case DK_BTN1_MSK:
        if (button_state & DK_BTN1_MSK)
        {
            LOG_DBG("Button 1 ignored");
        }
        break;
    case DK_BTN2_MSK:
        if (button_state & DK_BTN2_MSK)
        {
            LOG_DBG("Button 2 ignored");
        }
        break;
    }
}

int main(void)
{
    int err = 0;

    err = dk_leds_init();
    if (err != 0)
    {
        LOG_ERR("Failed to initialize the LED library");
    }

    /* Initializes lte modem */
    err = modem_configure();
    if (err)
    {
        LOG_ERR("Failed to configure the modem");
        return 0;
    }

    if (dk_buttons_init(button_handler) != 0)
    {
        LOG_ERR("Failed to initialize the buttons library\n");
    }

    k_sem_take(&run_sample, K_FOREVER);

    k_sem_give(&location_start_thread);
}
```

## src/location.c
```c
#include "location.h"

LOG_MODULE_REGISTER(LOCATION, LOG_LEVEL_DBG);

static struct k_mutex request_mutex; // Protects location data variables, no two processes should read and write at the same time

enum location_state
{
    STATE_INIT,
    STATE_IDLE,
    STATE_GET_DATA,
    STATE_ERROR
};
static enum location_state locationState = STATE_INIT;

static struct location_event_data location_data;

static K_SEM_DEFINE(location_event, 0, 1);

static K_SEM_DEFINE(time_update_finished, 0, 1);

static void date_time_evt_handler(const struct date_time_evt *evt)
{
    k_sem_give(&time_update_finished);
}

static void print_fix_data(void)
{
    // Print location information
    LOG_INF("Printing location:\n");
    LOG_INF("  method: %s\n", location_method_str(location_data.method));
    LOG_INF("  Latitude: %.6f", location_data.location.latitude);
    LOG_INF("  Longitude: %.6f", location_data.location.longitude);
    LOG_INF("  Accuracy: %.1f m", (double)location_data.location.accuracy);
    LOG_INF("  Google maps URL: https://maps.google.com/?q=%.06f,%.06f\n\n",
            location_data.location.latitude, location_data.location.longitude);
}

static void location_event_handler(const struct location_event_data *event_data)
{
    switch (event_data->id)
    {
    case LOCATION_EVT_LOCATION:
        location_data = *event_data;
        print_fix_data();
        break;

    case LOCATION_EVT_TIMEOUT:
        LOG_INF("Getting location timed out\n\n");
        break;

    case LOCATION_EVT_ERROR:
        LOG_INF("Getting location failed\n\n");
        break;

    case LOCATION_EVT_GNSS_ASSISTANCE_REQUEST:
        LOG_INF("Getting location assistance requested (A-GNSS). Not doing anything.\n\n");
        break;

    case LOCATION_EVT_GNSS_PREDICTION_REQUEST:
        LOG_INF("Getting location assistance requested (P-GPS). Not doing anything.\n\n");
        break;

    default:
        LOG_INF("Getting location: Unknown event\n\n");
        break;
    }

    k_sem_give(&location_event);
}

static void location_event_wait(void)
{
    k_sem_take(&location_event, K_FOREVER);
}

int location_init_system(void)
{
    int err;

    if (dk_leds_init() != 0)
    {
        LOG_ERR("Failed to initialize the LED library");
        return -1;
    }

    /* Enable PSM. */
    lte_lc_psm_req(true);
    lte_lc_connect();

    err = location_init(location_event_handler);
    if (err)
    {
        LOG_INF("Initializing the Location library failed, error: %d\n", err);
        return -1;
    }

    k_mutex_init(&request_mutex);
    // k_sem_init(&data_retrieved_sem, 0, 1);

    return 0;
}

static void location_init_get(void)
{
    k_mutex_lock(&request_mutex, K_FOREVER);

    int err;
    struct location_config config;
    enum location_method methods[] = {LOCATION_METHOD_GNSS};

    location_config_defaults_set(&config, ARRAY_SIZE(methods), methods);
    /* GNSS timeout is set to ten milliseconds, function is meant to update PGPS data upon init. */
    config.methods[0].gnss.timeout = 10;

    err = location_request(&config);
    if (err)
    {
        LOG_INF("Requesting location failed, error: %d\n", err);
        return;
    }

    location_event_wait();

    k_mutex_unlock(&request_mutex);
}

void location_default_get(void)
{
    k_mutex_lock(&request_mutex, K_FOREVER);

    int err;
    struct location_config config;
    enum location_method methods[] = {LOCATION_METHOD_GNSS};

    location_config_defaults_set(&config, ARRAY_SIZE(methods), methods);
    /* GNSS timeout is set to forever. */
    config.methods[0].gnss.timeout = SYS_FOREVER_MS;

    LOG_INF("Requesting location with the default configuration...\n");

    err = location_request(&config);
    if (err)
    {
        LOG_INF("Requesting location failed, error: %d\n", err);
        return;
    }

    location_event_wait();

    k_mutex_unlock(&request_mutex);
}

void locationFSM(void)
{
    k_sem_take(&location_start_thread, K_FOREVER);
    LOG_INF("Starting Location thread");
    while (true)
    {
        switch (locationState)
        {
        case STATE_INIT:
            if (location_init_system())
            {
                locationState = STATE_ERROR;
                break;
            }
            location_init_get();
            LOG_DBG("INIT -> IDLE");
            locationState = STATE_IDLE;
            break;
        case STATE_IDLE:
            k_msleep(CONFIG_GET_LOCATION_INTERVAL * 60000);
            LOG_DBG("IDLE -> GET");
            locationState = STATE_GET_DATA;
            break;
        case STATE_GET_DATA:
            location_default_get();
            LOG_DBG("GET -> IDLE");
            locationState = STATE_IDLE;
            break;
        case STATE_ERROR:
            LOG_ERR("Location initialization error retrying in 5s");
            k_msleep(5000);
            locationState = STATE_INIT;
            break;
        }
    }
}
```

## src/location.h
```c
#ifndef LOCATION_H
#define LOCATION_H

#include <stdio.h>
#include <string.h>

#include <zephyr/logging/log.h>
#include <zephyr/kernel.h>

#include <nrf_modem_at.h>
#include <modem/lte_lc.h>
#include <modem/location.h>
#include <modem/nrf_modem_lib.h>
#include <date_time.h>
#include <net/nrf_cloud_pgps.h>

#include <dk_buttons_and_leds.h> // For DK board LEDs/buttons

extern struct k_sem location_start_thread;

/**
 * @brief Initialize the location service system.
 *
 * @details Performs the following initialization steps:
 * 1. Initializes LED library
 * 2. Initializes modem library
 * 3. Registers LTE event handler
 * 4. Enables Power Saving Mode (PSM)
 * 5. Connects to LTE network
 * 6. Initializes location service
 * 7. Initializes request mutex
 *
 * @return 0 on success, negative error code on failure
 */
int location_init_system(void);

/**
 * @brief Retrieve location with default configuration.
 *
 * @details Uses both GNSS and cellular methods with custom timeout settings.
 *          GNSS timeout: 120 seconds
 *          Cellular timeout: 40 seconds
 *
 * @note This function is thread-safe and uses a mutex to protect location data.
 *       It will block until location is retrieved or an error occurs.
 */
void location_default_get(void);

/**
 * @brief Starts the location Finite State Machine (FSM).
 *
 * This function should be run in a dedicated thread and will handle:
 * - Initialization of location services
 * - Periodic location retrieval
 * - Error handling and recovery
 */
void locationFSM(void);

#endif /* LOCATION_H */
```
